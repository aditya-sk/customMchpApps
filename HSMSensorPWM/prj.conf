## CMakeLists.txt
```
# SPDX-License-Identifier: Apache-2.0

cmake_minimum_required(VERSION 3.20.0)
find_package(Zephyr REQUIRED HINTS $ENV{ZEPHYR_BASE})

project(HSMSensorPWM)

target_sources(app PRIVATE src/main.c src/app_pwm_state.c src/app_sensor_state.c src/app_button.c)
target_include_directories(app PRIVATE ${CMAKE_CURRENT_SOURCE_DIR}/include)
```

## prj.conf
```kconfig
CONFIG_SMF_ANCESTOR_SUPPORT=y
CONFIG_SMF=y
CONFIG_GPIO=y
CONFIG_I2C=y
CONFIG_PWM=y
CONFIG_SENSOR=y
CONFIG_BNO055=y
CONFIG_BNO055_TRIGGER=y
CONFIG_EVENTS=y
CONFIG_LOG=y
CONFIG_REBOOT=y
```

## src/main.c
```c
// Zephyr library header files
#include <zephyr/kernel.h>
#include <zephyr/smf.h>
#include <zephyr/device.h>
#include <zephyr/devicetree.h>
#include <zephyr/logging/log.h>
#include <zephyr/drivers/gpio.h>
#include <zephyr/drivers/pwm.h>
#include <zephyr/drivers/i2c.h>
#include <zephyr/drivers/sensor.h>



// Application header with Enums, Structure and function prototype
#include <app_pwm_state.h>
#include <app_button.h>
#include <app_sensor_state.h>

// sensor library header file
#include <bno055.h>

LOG_MODULE_REGISTER(main_LOG);

/* User defined object */
struct FSMContext stateMachineInfo;


// TODO #1: Event Based HSM with funciton pointer mapping with states. 
const struct smf_state stateTable[NUM_STATES] = 
{

};


// TODO #5: Main function to initialize the SMF, Events, and start the state machine with a specific state.
int main(void)
{

        return 0;
}
```

## include/app_button.h
```c
#ifndef APP_BUTTON_STATE_H
#define APP_BUTTON_STATE_H

#include <app_pwm_state.h>

// List of Events
#define EVENT_BTN_PRESS BIT(0) 



#define DEBOUNCE_DELAY_MS 1000

#define SW0_NODE        DT_ALIAS(userbutton)
#if !DT_NODE_HAS_STATUS_OKAY(SW0_NODE)
#error "Unsupported board: sw0 devicetree alias is not defined"
#endif

extern volatile enum bno055_sensor_channel currentChannel;


enum smf_state_result ChannelSelect_RUN(void* ptrData);

int init_SW0(void);
void buttonPressed_handler(const struct device *dev, struct gpio_callback *cb, uint32_t pins);


#endif // APP_BUTTON_STATES_H
```

## include/app_pwm_state.h
```c
#ifndef APP_PWM_STATE_H
#define APP_PWM_STATE_H



#define PERIOD_NS PWM_SEC(1U)   // 1 sec = 1,000,000,000 ns

#define TIMEOUT_FOUR_SEC K_SECONDS(4U)
#define TIMEOUT_TWO_SEC K_SECONDS(2U)

#define PERIOD_DIVISOR 3U

typedef enum  {
    PARENT,       // child to parent
    INITIALIZE,
    LED_BLINK,          // period
    SAMPLE_FORMAT,      // fetch the sample and console 
    ERROR_STATE,        // Error state
    NUM_STATES          // array size (Just optional)
}APP_State;

/* User defined object */
struct FSMContext 
{   /* This must be first */
    struct smf_ctx ctx;
    /* Events for toggling */
    struct k_event smf_event;
    uint32_t events;
};
/* Object used in multiple files*/
extern struct pwm_dt_spec pwmBlink;
extern struct FSMContext stateMachineInfo;
extern const struct smf_state stateTable[NUM_STATES];


// Init sate function prototype
void init_ENTRY(void* ptrData);
enum smf_state_result init_RUN(void* ptrData);
void init_EXIT(void* ptrData);



// S1 funciton prototype
enum smf_state_result ledPWM_RUN(void* ptrData);
void ledPWM_EXIT(void* ptrData);

// state with only error handling and resume
enum smf_state_result errorHandle_RUN(void* ptrData);


#endif // APP_PWM_STATES_H
```

## src/app_button.c
```c
// Zephyr library header files
#include <zephyr/kernel.h>
#include <zephyr/smf.h>
#include <zephyr/device.h>
#include <zephyr/devicetree.h>
#include <zephyr/logging/log.h>
#include <zephyr/drivers/gpio.h>
#include <zephyr/drivers/pwm.h>
#include <zephyr/drivers/i2c.h>
#include <zephyr/drivers/sensor.h>



// Application header with Enums, Structure and function prototype
#include <app_pwm_state.h>
#include <app_button.h>
#include <app_sensor_state.h>

// sensor library header file
#include <bno055.h>

LOG_MODULE_REGISTER(button_LOG);

// get devicetree node
const struct gpio_dt_spec button = GPIO_DT_SPEC_GET_OR(SW0_NODE, gpios, {0});
// callback structures
struct gpio_callback buttonCallback;
// to track the last button press
static uint32_t lastTime = 0U;

volatile enum bno055_sensor_channel currentChannel = BNO055_SENSOR_CHAN_CALIBRATION_SGAM;


// TODO #4: Parent state that handles the events propogated from child.
enum smf_state_result ChannelSelect_RUN(void* ptrData)
{
        
        
}


int init_SW0(void)
{
    int ret;
        if (!gpio_is_ready_dt(&button)) 
        {
                LOG_ERR("Error: button device %s is not ready\n", button.port->name);
                return -1;
        }

        ret = gpio_pin_configure_dt(&button, GPIO_INPUT);
        if (ret != 0) 
        {
                LOG_ERR("Error %d: failed to configure %s pin %d\n", ret, button.port->name, button.pin);
                return -1;
        }

        ret = gpio_pin_interrupt_configure_dt(&button, GPIO_INT_EDGE_TO_ACTIVE);
        if (ret != 0) 
        {
                LOG_ERR("Error %d: failed to configure interrupt on %s pin %d\n", ret, button.port->name, button.pin);
                return -1;
        }

        gpio_init_callback(&buttonCallback, buttonPressed_handler, BIT(button.pin));
        gpio_add_callback(button.port, &buttonCallback);
        return 0;
}


void buttonPressed_handler(const struct device *dev, struct gpio_callback *cb, uint32_t pins)
{
        
        uint32_t currentTime = k_uptime_get_32();
        if(currentTime - lastTime > DEBOUNCE_DELAY_MS)
        {
                LOG_INF("Captured the Button event\r\n");
                /* Generate Button Press Event */
                k_event_post(&stateMachineInfo.smf_event, EVENT_BTN_PRESS);
                lastTime = currentTime; 
        }else{
                LOG_INF("Debounced button press ignored\r\n");
        }
}
```

## src/app_pwm_state.c
```c
// Zephyr library header files
#include <zephyr/kernel.h>
#include <zephyr/smf.h>
#include <zephyr/device.h>
#include <zephyr/devicetree.h>
#include <zephyr/logging/log.h>
#include <zephyr/drivers/gpio.h>
#include <zephyr/drivers/pwm.h>
#include <zephyr/drivers/i2c.h>
#include <zephyr/drivers/sensor.h>
#include <zephyr/sys/reboot.h>



// Application header with Enums, Structure and function prototype
#include <app_pwm_state.h>
#include <app_button.h>
#include <app_sensor_state.h>

// sensor library header file
#include <bno055.h>


LOG_MODULE_REGISTER(pwmLED_LOG);



struct pwm_dt_spec pwmBlink  = PWM_DT_SPEC_GET(DT_ALIAS(userled));



void init_ENTRY(void* ptrData) 
{
        LOG_INF("Init Peripherals\r\n");
        
        if(0 != initI2CNode()){
            
            LOG_ERR("Error occured while I2C init\r\n");
        }
        if(true != pwm_is_ready_dt(&pwmBlink))
        {
            LOG_ERR("Error occured while PWM init\r\n");
        
        }
        if(0 != init_SW0())
        {
            LOG_ERR("Error occured while GPIO init\r\n");

        }
        
        k_sleep(TIMEOUT_FOUR_SEC); 
}


enum smf_state_result init_RUN(void* ptrData)
{

        pwm_set_dt(&pwmBlink, PERIOD_NS, PERIOD_NS);  //(0 duty cycle)
        LOG_INF("Welcome to HSM State Machines\r\n");
        k_sleep(TIMEOUT_TWO_SEC); 
        smf_set_state(SMF_CTX(&stateMachineInfo), &stateTable[LED_BLINK]); // Transition to caliberation mode
        return SMF_EVENT_HANDLED;
}


void init_EXIT(void* ptrData)
{
        LOG_INF("Completed Init for I2C, PWM and GPIO Peripherals\r\n");
}

// TODO #2: Main function to initialize the SMF, Events, and start the state machine with a specific state.
enum smf_state_result ledPWM_RUN(void* ptrData)
{

}

void ledPWM_EXIT(void* ptrData)
{
    
    pwm_set_dt(&pwmBlink, PERIOD_NS, 0);
    LOG_INF("PWM Blink Completed\r\n");
}


// Error State has only error actions
enum smf_state_result errorHandle_RUN(void* ptrData)
{
    const struct FSMContext* info = (const struct FSMContext*)ptrData;

        if (info->ctx.previous == &stateTable[LED_BLINK] || info->ctx.previous == &stateTable[SAMPLE_FORMAT]) 
        {
                smf_set_state(SMF_CTX(&stateMachineInfo), &stateTable[INITIALIZE]);
                return SMF_EVENT_HANDLED;
        }
        else
        {
                // reboot the hardware.
                sys_reboot(SYS_REBOOT_COLD);
                return SMF_EVENT_HANDLED;
        }
}
```

## src/app_sensor_state.c
```c
// Zephyr library header files
#include <zephyr/kernel.h>
#include <zephyr/smf.h>
#include <zephyr/device.h>
#include <zephyr/devicetree.h>
#include <zephyr/logging/log.h>
#include <zephyr/drivers/gpio.h>
#include <zephyr/drivers/pwm.h>
#include <zephyr/drivers/i2c.h>
#include <zephyr/drivers/sensor.h>

// Application header with Enums, Structure and function prototype
#include <app_pwm_state.h>
#include <app_button.h>
#include <app_sensor_state.h>

// sensor library header file
#include <bno055.h>



LOG_MODULE_REGISTER(sensor_LOG);


// get the devicetree node and allocate memory for data
const struct device* bno055_node = DEVICE_DT_GET(DT_NODELABEL(bno055));

static struct sensor_value linearAcceleration[3]; 
static struct sensor_value calib[4];
static struct sensor_value gravityData[3];
static struct sensor_value eulerData[3];
static struct sensor_value quaternionData[4];

// TODO #3: fetch the data from sensor, filter based on the channel of the sensor, and transition to SENSOR_CONSOLE
enum smf_state_result dataFetch_RUN(void* ptrData)
{
	 
}


int initI2CNode()
{

    if (!device_is_ready(bno055_node)) {
		LOG_ERR("Device %s is not ready\r\n", bno055_node->name);
		smf_set_state(SMF_CTX(&stateMachineInfo), &stateTable[ERROR_STATE]);
		return -1;
	}
	k_sleep(K_MSEC(100));
	struct sensor_value config = {
		.val1 = BNO055_MODE_NDOF,
		.val2 = 0,
	};
	k_sleep(K_MSEC(100));
	sensor_attr_set(bno055_node, SENSOR_CHAN_ALL, SENSOR_ATTR_CONFIGURATION, &config);
	config.val1 = BNO055_POWER_NORMAL;
	config.val2 = 0;
	k_sleep(K_MSEC(50));
	sensor_attr_set(bno055_node, SENSOR_CHAN_ALL, BNO055_SENSOR_ATTR_POWER_MODE, &config);
	return 0;
	
}
```
