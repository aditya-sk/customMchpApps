## prj.conf
```kconfig
CONFIG_SMF=y
CONFIG_GPIO=y
CONFIG_PWM=y
```

## boards/same54_xpro.overlay
```dts
/ {
    aliases {
        userled = &pwm_led0;
        userbutton = &button0;
	};
};
```

## src/main.c
```c
// Zephyr header
#include <zephyr/kernel.h>
#include <zephyr/sys/printk.h>
#include <zephyr/device.h>
#include <zephyr/drivers/pwm.h>
#include <zephyr/drivers/gpio.h>
#include <zephyr/smf.h>

// application header
#include <app_pwm_state.h>


/* User defined object */
struct FSMContext stateMachineInfo;

// TODO #1: FSM table with the function pointer and respective states.
const struct smf_state stateTable[NUM_STATES] = 
{
    [PWM_INITIAL] = SMF_CREATE_STATE(initPWM_ENTRY, initPWM_RUN, initPWM_EXIT, NULL, NULL),
    [CALIBRATION] = SMF_CREATE_STATE(calibratePWM_ENTRY, NULL, calibration_EXIT, NULL, NULL),
    [FIRST_STATE] = SMF_CREATE_STATE(NULL, ledPWM_RUN, firstState_EXIT, NULL, NULL),
    [SECOND_STATE] = SMF_CREATE_STATE(secondState_ENTRY, checkPeriod_RUN, NULL, NULL, NULL),
    [ERROR_STATE] = SMF_CREATE_STATE(NULL, errorHandle_RUN, NULL, NULL, NULL)
    
};

// TODO #9:Main function to initialize the SMF and start the state machine
int main(void)
{
        int ret;
        /* Set initial state for FSM*/
        smf_set_initial(SMF_CTX(&stateMachineInfo), &stateTable[PWM_INITIAL]);

        while(true)
        {   // start SMF for PWMMachine
            ret = smf_run_state(SMF_CTX(&stateMachineInfo));
            if(ret < 0)
            {
                return -1;
            }
            k_sleep(TIMEOUT_FOUR_SEC);
        }
        return 0;
}
```

## include/app_pwm_state.h
```c
#ifndef APP_PWM_STATE_H
#define APP_PWM_STATE_H


// Assuming for 7-bit 
#define MIN_PERIOD PWM_SEC(1U) / 128U    // 7,812,500 ns
#define MAX_PERIOD PWM_SEC(1U)          // // 1 sec = 1,000,000,000 ns


#define TIMEOUT_FOUR_SEC K_SECONDS(4U)
#define TIMEOUT_TWO_SEC K_SECONDS(2U)

#define PERIOD_DOUBLE 2U
#define PERIOD_HALF_DIVISOR 2U

typedef enum  {
    PWM_INITIAL,     // LED OFF
    CALIBRATION,
    FIRST_STATE,       // Slow Blink
    SECOND_STATE,      // Fast Blink
    ERROR_STATE,     // Error state
    NUM_STATES      // for array sizing (Just optional)
}APP_State;

/* User defined object */
struct FSMContext 
{   /* This must be first */
    struct smf_ctx ctx;
    // /* Events */
    // struct k_event smf_event;
    // uint32_t events;
};
/* Object used in multiple files*/
extern struct pwm_dt_spec pwmBlink;
extern struct FSMContext stateMachineInfo;
extern const struct smf_state stateTable[NUM_STATES];

// Init sate function prototype
void initPWM_ENTRY(void* ptrData);
void initPWM_RUN(void* ptrData);
void initPWM_EXIT(void* ptrData);

// Caliberation state function prototype
void calibratePWM_ENTRY(void* ptrData);
void calibration_EXIT(void* ptrData);

// S1 funciton prototype
void ledPWM_RUN(void* ptrData);
void firstState_EXIT(void* ptrData);

//S2 function prototype
void secondState_ENTRY(void* ptrData);
void checkPeriod_RUN(void* ptrData);


// state with only error handling and resume
void errorHandle_RUN(void* ptrData);


#endif // APP_PWM_STATES_H
```

## src/app_pwm_state.c
```c
// Zephyr library header files
#include <zephyr/kernel.h>
#include <zephyr/sys/printk.h>
#include <zephyr/device.h>
#include <zephyr/sys/util.h>
#include <zephyr/drivers/pwm.h>
#include <zephyr/drivers/gpio.h>
#include <zephyr/smf.h>

// Application header with Enums, Structure and function prototype
#include <app_pwm_state.h>

// TODO #2: get the devicetree node
struct pwm_dt_spec pwmBlink  = PWM_DT_SPEC_GET(DT_ALIAS(userled));


// Global variables for calculation max, periond and direction to multiple or divide by 2
static uint32_t max_period;
static uint32_t period;
uint8_t direction = 0U;


/*
 * FSM 5 State Transition:
 *
 *	    ---> Init_ENTRY --> Init_RUN --> Init_EXIT -----------------------------|
 *                                                                              |
 *      |-----------------------------------------------------------------------|
 *      |
 *      |--> caliberatePWM_ENTRY --> caliberation_EXIT -------------------------|
 *      |-----------------------------------------------------------------------|
 *      |
 *      |--> ledPWM_RUN --> firstState_EXIT  -----------------------------------|
 *                                                                              |
 *      |-----------------------------------------------------------------------|
 *      |
 *      |----> checkPeriod_RUN --> stateSecond_exit ----------------------------|
 *                                                                              |
 *      |-----------------------------------------------------------------------|
 *      |
 *      |--> errorHandle --> FIRST_S1    ---------------------------------------|
 *      |                                                                       |
 *                       --> INITIAL_S0  ---------------------------------------|
 */    


// TODO #3: Checking if the PWM is ready or not 
void initPWM_ENTRY(void* ptrData) 
{
    printk("Enter to Init (LED OFF)\r\n");
    
    if(!pwm_is_ready_dt(&pwmBlink))
    {
        printk("Error occure while PWM init\r\n");
        // Transition to error state
        smf_set_state(SMF_CTX(&stateMachineInfo), &stateTable[ERROR_STATE]);
    }
    k_sleep(TIMEOUT_FOUR_SEC); 
}

//TODO #4: Set the parameter to zero
void initPWM_RUN(void* ptrData)
{
    pwm_set_dt(&pwmBlink, 0, 0);  //(0 duty cycle)
    printk("Completed and PWM is ready\r\n");
    smf_set_state(SMF_CTX(&stateMachineInfo), &stateTable[CALIBRATION]); // Transition to caliberation mode
    k_sleep(TIMEOUT_FOUR_SEC); 
}

//TODO #5: Exit from init PWM state
void initPWM_EXIT(void* ptrData)
{
    printk("Completed the Init PWM LED\r\n");
}

// TODO #6: Calibrating for Maximumm period based on MCU clock
void calibratePWM_ENTRY(void* ptrData)
{
    printk("In CALIBRATION state\n");
    // Calibrate maximum period
    max_period = MAX_PERIOD;
    printk("Calibrated for max period %u nsec\r\n", max_period);
    k_sleep(TIMEOUT_FOUR_SEC); 
    while (pwm_set_dt(&pwmBlink, max_period, max_period / PERIOD_HALF_DIVISOR)) 
    {
        max_period /= PERIOD_HALF_DIVISOR;
        if (max_period < (5U * MIN_PERIOD)) 
        {
            printk("Error: PWM device doesn't support the period at least %lu\n", 4U * MIN_PERIOD);
            // Transition to error State
            smf_set_state(SMF_CTX(&stateMachineInfo), &stateTable[ERROR_STATE]);
            break;
        }
    }
    
    period = max_period;
    k_sleep(TIMEOUT_FOUR_SEC); 
    smf_set_state(SMF_CTX(&stateMachineInfo), &stateTable[FIRST_STATE]); 
}

// Exiting from calibration state
void calibration_EXIT(void* ptrData)
{
    printk("Completed the caliberation for MAX period\r\n");
}

// TODO #7: Set Period and pulse for PWM using PWM interface API
void ledPWM_RUN(void* ptrData)
{
    int ret;
    const struct FSMContext* info = (const struct FSMContext*)ptrData;
    printk("S1 Period: %u nsec\r\n", period);
    ret = pwm_set_dt(&pwmBlink, period, period / PERIOD_HALF_DIVISOR);
        if(ret < 0)
        {
            printk("Error %d: failed to set pulse width in state S1\r\n", ret);
            smf_set_state(SMF_CTX(info), &stateTable[ERROR_STATE]); // Transition to S0 in case of error
        }
    k_sleep(TIMEOUT_FOUR_SEC); // Stay in S1 for 4 seconds before transitioning
    smf_set_state(SMF_CTX(info), &stateTable[SECOND_STATE]); // Transition to S2 (fast blink)

}

// Exiting from first state with a PWM Period
void firstState_EXIT(void* ptrData)
{
    printk("Exit S1 State\r\n");
}

// S2: Reduce the period by factor of 2
void secondState_ENTRY(void* ptrData) 
{
    printk("Enter S2 State\r\n");
}

// TODO #8: Reduce the period by factor of 2
void checkPeriod_RUN(void* ptrData) 
{   
    const struct FSMContext* info = (const struct FSMContext*)ptrData;
    period = direction ? (period * PERIOD_DOUBLE) : (period / PERIOD_HALF_DIVISOR);
    printk("S2 %s\r\n", direction ? "Increment period" : "Decrement Period");
        if (period > max_period)
        {
            period = max_period / PERIOD_HALF_DIVISOR;
            direction = 0U;
        }else if (period < MIN_PERIOD){
            period = MIN_PERIOD * PERIOD_DOUBLE;
            direction = 1U;
        }
    k_sleep(TIMEOUT_FOUR_SEC); // Stay in S2 for 4 seconds before transitioning
    smf_set_state(SMF_CTX(info), &stateTable[FIRST_STATE]); // Transition back to S1 (slow blink)

}

// Error state has only error action
void errorHandle_RUN(void* ptrData)
{
    const struct FSMContext* info = (const struct FSMContext*)ptrData;
    if(info->ctx.previous == &stateTable[FIRST_STATE] || info->ctx.previous == &stateTable[SECOND_STATE])
    {
            smf_set_state(SMF_CTX(&info), &stateTable[CALIBRATION]);
    }else{
            // reset the PMW module and its parameter
            smf_set_state(SMF_CTX(&info), &stateTable[PWM_INITIAL]);
    }
}
```
